## conf/layer.conf
```bitbake
# We have a conf and classes directory, add to BBPATH
BBPATH .= ":${LAYERDIR}"

# We have a recipes-* directories, add to BBFILES
BBFILES += "${LAYERDIR}/recipes-*/*/*.bb \
	${LAYERDIR}/recipes-*/*/*.bbappend"

BBFILE_COLLECTIONS += "meta-100ask-st"
BBFILE_PATTERN_meta-100ask-st := "^${LAYERDIR}/"
BBFILE_PRIORITY_meta-100ask-st = "6"

EULA_FILE_ST_stm32mpcommon = "${LAYERDIR}/conf/eula/${MACHINE}"
EULA_FILE_ST_MD5SUM_stm32mpcommon = "8b505090fb679839cefbcc784afe8ce9"
LICENSE_PATH += "${LAYERDIR}/files/licenses"


LAYERDEPENDS_meta-100ask-st = "core"
LAYERSERIES_COMPAT_meta-100ask-st = "dunfell"


# Set a variable to get the STM32MP BSP location
#?STM32MP_BASE = "${LAYERDIR}"

# This should only be incremented on significant changes that will
# cause compatibility issues with other layers
LAYERVERSION_meta-100ask-st = "1"
LAYERSERIES_COMPAT_meta-100ask-st = "dunfell"

# for optee-os-stm32mp dependency
#? LAYERDEPENDS_meta-100ask-st = "core openembedded-layer meta-python"
```

## conf/machine/include/100ask-machine-providers-stm32mp.inc
```bitbake
# =========================================================================
# Kernel
# =========================================================================
PREFERRED_PROVIDER_virtual/kernel = "linux-100ask"

# =========================================================================
# u-boot
# =========================================================================
PREFERRED_PROVIDER_virtual/bootloader = "u-boot-100ask"
PREFERRED_PROVIDER_u-boot = "u-boot-100ask"

# =========================================================================
# trusted-firmware-a
# =========================================================================
PREFERRED_PROVIDER_virtual/trusted-firmware-a = "tf-a-100ask"
PREFERRED_PROVIDER_virtual/trusted-firmware-a-serialboot = "tf-a-100ask-serialboot"
# Define default TF-A config
TF_A_CONFIG_append_pn-tf-a-100ask-serialboot = " serialboot "
TF_A_CONFIG_append_pn-tf-a-100ask = " ${@bb.utils.contains('BOOTSCHEME_LABELS', 'trusted', 'trusted', '', d)} "
TF_A_CONFIG_append_pn-tf-a-100ask = " ${@bb.utils.contains('BOOTSCHEME_LABELS', 'optee', 'optee', '', d)} "

# =========================================================================
# optee-os
# =========================================================================
#PREFERRED_PROVIDER_virtual/optee-os = "optee-os-stm32mp"
```
